## app/boards/my_board/board.yml
```yaml
board:
  name: my_board
  full_name: My_Board Development Board
  vendor: iomico
  socs:
    - name: stm32f407xx
```

## app/boards/our_board/board.yml
```yaml
board:
  name: our_board
  full_name: Our_Board Development Board
  vendor: others
  socs:
    - name: stm32f407xx
```
